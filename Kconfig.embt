## lib/settings/Kconfig
```kconfig
# Copyright (c) 2018 Nordic Semiconductor ASA
# Copyright (c) 2025-2026 Analog Devices, Inc.
# SPDX-License-Identifier: Apache-2.0

menuconfig SETTINGS
	bool "Settings"
	select SETTINGS_FILE
	help
	  The settings subsystem allows its users to serialize and
	  deserialize state in memory into and from non-volatile memory.
	  It supports several back-ends to store and load serialized data from
	  and it can do so atomically for all involved modules.

if SETTINGS

config SETTINGS_RUNTIME
	bool "Runtime access to settings handlers"
	help
	  Enables direct handler get/set/commit APIs without persistent storage.

config SETTINGS_DYNAMIC_HANDLERS
	bool "dynamic settings handlers"
	default y
	help
	  Enables the use of dynamic settings handlers

config SETTINGS_SAVE_SINGLE_SUBTREE_WITHOUT_MODIFICATION
	bool "Save single or subtree (without modification) function"
	help
	  Includes the `settings_save_subtree_or_single_without_modification()` function which
	  allows saving an item that might be a subtree or a single setting, without changing the
	  value. To save a single setting, the setting must support reading and writing of it
	  using the `h_get()` function pointer and must support reading it into a large buffer
	  size.

config SETTINGS_SAVE_SINGLE_SUBTREE_WITHOUT_MODIFICATION_VALUE_SIZE
	int "Save single or subtree (without modification) maximum value size"
	default 65
	depends on SETTINGS_SAVE_SINGLE_SUBTREE_WITHOUT_MODIFICATION
	help
	  The maximum size of a single setting that can be saved using the
	  `settings_save_subtree_or_single_without_modification()` function - note that this will
	  use stack memory.

# Hidden option to enable encoding length into settings entry

config SETTINGS_ENCODE_LEN
	bool

config SETTINGS_FILE
	bool
	default y
	select SETTINGS_ENCODE_LEN
	help
	  Preserve the settings store and handler design with a POSIX file
	  backend. No flash, NVS, FCB or other persistent backend is built.

config SETTINGS_FILE_PATH
	string "Default settings file"
	default ".embt/settings.bin"
	depends on SETTINGS_FILE
	help
	  Absolute path or path relative to the process working directory.
	  Missing directories are created with owner-only permissions.

config SETTINGS_FILE_MAX_LINES
	int "File compression threshold"
	range 2 2147483647
	default 32
	depends on SETTINGS_FILE
	help
	  Append records and compact superseded values at this threshold.


endif # SETTINGS
```
