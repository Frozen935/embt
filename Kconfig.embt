## Kconfig.embt
```kconfig
# /****************************************************************************
#  *  Copyright (C) 2026 EmBT contributors
#  *
#  * Licensed under the Apache License, Version 2.0 (the "License");
#  * you may not use this file except in compliance with the License.
#  * You may obtain a copy of the License at
#  *
#  *      http://www.apache.org/licenses/LICENSE-2.0
#  *
#  * Unless required by applicable law or agreed to in writing, software
#  * distributed under the License is distributed on an "AS IS" BASIS,
#  * WITHOUT WARRANTIES OR CONDITIONS OF ANY KIND, either express or implied.
#  * See the License for the specific language governing permissions and
#  * limitations under the License.
#  ***************************************************************************/

menuconfig EMBT_STACK
	bool "EmBT stack"
	help
	  Enable the entire EmBT configuration tree and build targets.
	  Disabling this option disables all component configuration choices.

if EMBT_STACK

menu "Build and target"

config EMBT_64BIT
	bool "64-bit pointer ABI"
	default y
	help
	  Select the ABI of the compiler target, not the host running Python.
	  Disable for a 32-bit target. CMake checks the actual pointer size.

choice EMBT_BYTE_ORDER
	prompt "Target byte order"
	default EMBT_LITTLE_ENDIAN

config EMBT_LITTLE_ENDIAN
	bool "Little endian"

config EMBT_BIG_ENDIAN
	bool "Big endian"

endchoice

config EMBT_APP_VERSION
	string "Application version"
	default ""
	help
	  Optional application version used by the Device Information Service.

choice EMBT_OPTIMIZATION
	prompt "Optimization"
	default NO_OPTIMIZATIONS

config NO_OPTIMIZATIONS
	bool "No optimization (-O0)"

config SIZE_OPTIMIZATIONS
	bool "Optimize for size (-Os)"

config SPEED_OPTIMIZATIONS
	bool "Optimize for speed (-O2)"

endchoice

config EMBT_EXPERIMENTAL
	bool
	help
	  Set by selected experimental EmBT features.

endmenu

rsource "osdep/Kconfig"
rsource "base/Kconfig"
rsource "Kconfig.log"

menu "Runtime interface requirements"

config SYSTEM_WORKQUEUE_PRIORITY
	int "System workqueue priority"
	default -1
	help
	  Bluetooth adds a cooperative range when its workqueue needs it.
	  POSIX priority mapping is a separate porting task.

config SYSTEM_WORKQUEUE_STACK_SIZE
	int "System workqueue stack requirement"
	range 1 2147483647
	default 1024
	help
	  Retains the upstream byte requirement. A POSIX implementation must
	  also obey the host's minimum stack size and scheduling constraints.


config ASSERT
	bool "Assertions"
	default y

endmenu

menu "Optional platform adapters"

config EMBT_MONITOR
	bool "HCI monitor with an explicitly installed binary sink"
	select BT_MONITOR

endmenu

menu "External dependency requirements"

rsource "third_party/mbedtls/Kconfig"

config LIBSBC
	bool "Require SBC codec support"
	default n

config LIBLC3
	bool "Require LC3 codec support"
	default n

config HAS_RANDOM_GENERATOR
	bool
	default n
	help
	  Enable only when the random interface has a real implementation.

endmenu

# Transport and Controller capabilities.

config BT_HCI_SET_PUBLIC_ADDR
	bool
	default n
	help
	  Enabled only by a transport implementing the public-address hook.

rsource "bluetooth/Kconfig.constants"
rsource "lib/Kconfig"
rsource "drivers/Kconfig"
rsource "bluetooth/Kconfig"

rsource "test/bluetooth/Kconfig"

endif # EMBT_STACK
```
