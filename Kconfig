## Kconfig
```kconfig
# /****************************************************************************
#  *  Copyright (C) 2026 EmBT contributors
#  *
#  * Licensed under the Apache License, Version 2.0 (the "License");
#  * you may not use this file except in compliance with the License.
#  * You may obtain a copy of the License at
#  *
#  *      http://www.apache.org/licenses/LICENSE-2.0
#  *
#  * Unless required by applicable law or agreed to in writing, software
#  * distributed under the License is distributed on an "AS IS" BASIS,
#  * WITHOUT WARRANTIES OR CONDITIONS OF ANY KIND, either express or implied.
#  * See the License for the specific language governing permissions and
#  * limitations under the License.
#  ***************************************************************************/

mainmenu "EmBT Configuration"

menuconfig EMBT_STACK
	bool "EmBT stack"
	help
	  Enable the entire EmBT configuration tree and build targets.
	  Disabling this option disables all component configuration choices.

if EMBT_STACK

menu "Build and target"

config EMBT_64BIT
	bool "64-bit pointer ABI"
	default y
	help
	  Select the ABI of the compiler target, not the host running Python.
	  Disable for a 32-bit target. CMake checks the actual pointer size.

choice EMBT_BYTE_ORDER
	prompt "Target byte order"
	default EMBT_LITTLE_ENDIAN

config EMBT_LITTLE_ENDIAN
	bool "Little endian"

config EMBT_BIG_ENDIAN
	bool "Big endian"

endchoice

config EMBT_APP_VERSION
	string "Application version"
	default ""
	help
	  Optional application version used by the Device Information Service.

config SOC
	string
	default "posix"

choice EMBT_OPTIMIZATION
	prompt "Optimization"
	default NO_OPTIMIZATIONS

config NO_OPTIMIZATIONS
	bool "No optimization (-O0)"

config SIZE_OPTIMIZATIONS
	bool "Optimize for size (-Os)"

config SPEED_OPTIMIZATIONS
	bool "Optimize for speed (-O2)"

endchoice

config EMBT_EXPERIMENTAL
	bool
	help
	  Set by selected experimental EmBT features.

endmenu

menu "Runtime interface requirements"

config NUM_PREEMPT_PRIORITIES
	int "Preemptible priority levels"
	range 0 127
	default 15

config SYSTEM_WORKQUEUE_PRIORITY
	int "System workqueue priority"
	default -1
	help
	  Bluetooth adds a cooperative range when its workqueue needs it.
	  POSIX priority mapping is a separate porting task.

config SYSTEM_WORKQUEUE_STACK_SIZE
	int "System workqueue stack requirement"
	range 1 2147483647
	default 1024
	help
	  Retains the upstream byte requirement. A POSIX implementation must
	  also obey the host's minimum stack size and scheduling constraints.

config ASSERT
	bool "Assertions"
	default y

config PRINTK
	bool "Require formatted console output"
	default y
	help
	  Retained HFP and diagnostic interfaces need output support. This
	  does not restore the retired Zephyr logging framework.

config POLL
	bool
	help
	  Requirement for the kernel-style poll interface, selected by Mesh.
	  It does not imply that POSIX poll alone implements that contract.

config EMBT_PORT_HAS_SHELL
	bool
	default n
	help
	  Enable only after a real shell implementation is integrated.

config SHELL
	bool

config SHELL_GETOPT
	bool

config GETOPT_LONG
	bool

endmenu

menu "External dependency requirements"

rsource "third_party/mbedtls/Kconfig"

config LIBSBC
	bool "Require SBC codec support"
	default n

config LIBLC3
	bool "Require LC3 codec support"
	default n

config HAS_RANDOM_GENERATOR
	bool
	default n
	help
	  Enable only when the random interface has a real implementation.

endmenu

# Legacy transport, board, memory and storage selectors; no providers.

config BT_H4
	bool
	default n

config BT_H5
	bool
	default n

config BT_HCI_SET_PUBLIC_ADDR
	bool
	default n
	help
	  Enabled only by a transport implementing the public-address hook.

config BT_HAS_HCI_VS
	default n

rsource "bluetooth/Kconfig.constants"
rsource "lib/Kconfig"
rsource "bluetooth/subsys/Kconfig"
rsource "bluetooth/drivers/Kconfig"
rsource "bluetooth/Kconfig"

endif # EMBT_STACK
```

## bluetooth/crypto/Kconfig
```kconfig
# Copyright (c) 2022 Nordic Semiconductor ASA
# SPDX-License-Identifier: Apache-2.0

config BT_CRYPTO
	bool
	select PSA_CRYPTO
	select PSA_WANT_KEY_TYPE_AES
	select PSA_WANT_ALG_CMAC
	select PSA_WANT_ALG_ECB_NO_PADDING
	help
	  This option enables the Bluetooth Cryptographic Toolbox.
```

## bluetooth/drivers/bluetooth/hci/Kconfig
```kconfig
# Copyright (c) 2016 Intel Corporation
# SPDX-License-Identifier: Apache-2.0

config BT_USERCHAN
	bool "Linux HCI user-channel transport"
	depends on BT_DRIVERS && BT_HCI
	help
	  Retain the Linux HCI user-channel transport sources for POSIX
	  porting. The native simulator and device-tree integration in
	  these sources still requires replacement before standalone use.
```

## bluetooth/subsys/Kconfig
```kconfig
# Copyright (c) 2016-2017 Intel Corporation
# Copyright (c) 2021 Nordic Semiconductor
# SPDX-License-Identifier: Apache-2.0

rsource "crc/Kconfig"
rsource "random/Kconfig"
rsource "settings/Kconfig"
```

## bluetooth/subsys/crc/Kconfig
```kconfig
# Copyright (c) 2016,2023 Intel Corporation
# Copyright (c) 2025 Renesas Electronics Corporation
# SPDX-License-Identifier: Apache-2.0

menuconfig CRC
	bool "Cyclic redundancy check (CRC) Support"
	help
	  Enable use of CRC.

if CRC

config CRC4
	bool "CRC-4 (Generic)"
	default y
	help
	  Implements a generic CRC-4 algorithm. This is suitable for platforms
	  without hardware CRC support. Offers flexibility but has lower performance
	  compared to hardware-based implementations.

config CRC4_TI
	bool "CRC-4 (TI Polynomial)"
	default y
	help
	  Implements the TI-specific CRC-4 algorithm. Commonly used in low-level
	  embedded communication where minimal CRC overhead is needed.

config CRC7_BE
	bool "CRC-7 (Big Endian)"
	default y
	help
	  Implements a CRC-7 algorithm with Big Endian bit order. Often used
	  in SD card protocols and other serial communication standards.

config CRC8
	bool "CRC-8 (Generic)"
	default y
	help
	  Implements a generic CRC-8 algorithm. Useful for small data integrity
	  checks such as checksums and simple communication protocols.

config CRC8_ROHC
	bool "CRC-8 (ROHC)"
	default y
	help
	  Implements the CRC-8 ROHC (Robust Header Compression) algorithm,
	  typically used in compressed IP header protocols and networking.

config CRC8_CCITT
	bool "CRC-8 (CCITT)"
	default y
	help
	  Implements the CRC-8 CCITT polynomial. Commonly used in
	  telecommunications and low-power sensor protocols.

config CRC16
	bool "CRC-16 (Generic)"
	default y
	help
	  Implements the generic CRC-16 algorithm. Frequently used in
	  storage, file transmission, and basic serial communication protocols.

config CRC16_ANSI
	bool "CRC-16 (ANSI)"
	default y
	help
	  Implements the ANSI variant of CRC-16, also known as CRC-16-IBM.
	  Commonly applied in legacy serial and file systems.

config CRC16_CCITT
	bool "CRC-16 (CCITT)"
	default y
	help
	  Implements the CCITT variant of CRC-16, widely used in
	  telecommunication systems such as XMODEM and HDLC protocols.

config CRC16_ITU_T
	bool "CRC-16 (ITU-T)"
	default y
	help
	  Implements the ITU-T (formerly CCITT) CRC-16 variant.
	  Popular in modem protocols and wireless communication standards.

config CRC16_REFLECT
	bool "CRC-16 (Reflected)"
	default y
	help
	  Implements the reflected (bit-reversed) variant of CRC-16-CCITT.
	  Useful in systems that process data in LSB-first order.

config CRC24_PGP
	bool "CRC-24 (PGP)"
	default y
	help
	  Implements a CRC24 algorithm, used in applications like Bluetooth
	  and certain cryptographic protocols.

config CRC32_C
	bool "CRC-32C"
	default y
	help
	  Implements the CRC32-C (Castagnoli) algorithm, optimized for
	  high-performance applications such as storage, networking,
	  and error detection in modern processors.

config CRC32_IEEE
	bool "CRC-32 (IEEE)"
	default y
	help
	  Implements the CRC32-IEEE (CRC-32) algorithm, commonly used
	  in Ethernet, ZIP file integrity checks, and other standard
	  networking and storage applications.


config CRC32_K_4_2
	bool "CRC-32K/4.2"
	default y
	help
	  Implement the CRC-32K/4.2 algorithm, a variant of the standard
	  CRC32-IEEE used in Ethernet, ZIP files, and other data integrity
	  applications.

config CRC32_MPEG2
	bool "CRC-32 (MPEG-2)"
	default y
	help
	  Implements the CRC-32/MPEG-2 algorithm (polynomial 0x04C11DB7,
	  initial value 0xFFFFFFFF, no input/output reflection, no final
	  XOR). Used by MPEG-2 transport streams (ISO/IEC 13818-1) and
	  commonly available in MCU CRC peripherals.

config CRC32_K_4_2_TABLE_256
	bool "CRC-32K/4.2 Table 256"
	help
	  Enables the software implementation of the CRC-32K/4.2 algorithm
	  using a 256-entry lookup table for faster computation.

endif # CRC
```

## bluetooth/subsys/random/Kconfig
```kconfig
# Copyright (c) 2017 Intel Corporation
# SPDX-License-Identifier: Apache-2.0

menu "Random Number Generators"

config PSA_CSPRNG_GENERATOR
	bool "Use PSA CSPRNG"
	depends on PSA_CRYPTO
	help
	  Enables a cryptographically secure random number generator
	  that uses the PSA Crypto API. This CSPRNG implementation
	  leverages the underlying PSA Crypto library's secure random
	  number generation capabilities, which may use hardware
	  entropy sources when available. The PSA CSPRNG provides
	  cryptographically secure random numbers suitable for
	  security-sensitive applications.

endmenu
```

## bluetooth/subsys/settings/Kconfig
```kconfig
# Copyright (c) 2018 Nordic Semiconductor ASA
# Copyright (c) 2025-2026 Analog Devices, Inc.
# SPDX-License-Identifier: Apache-2.0

menuconfig SETTINGS
	bool "Settings"
	help
	  The settings subsystem allows its users to serialize and
	  deserialize state in memory into and from non-volatile memory.
	  It supports several back-ends to store and load serialized data from
	  and it can do so atomically for all involved modules.

if SETTINGS

config SETTINGS_RUNTIME
	bool "runtime storage back-end"
	help
	  Enables runtime storage back-end.

config SETTINGS_DYNAMIC_HANDLERS
	bool "dynamic settings handlers"
	default y
	help
	  Enables the use of dynamic settings handlers

config SETTINGS_SAVE_SINGLE_SUBTREE_WITHOUT_MODIFICATION
	bool "Save single or subtree (without modification) function"
	help
	  Includes the `settings_save_subtree_or_single_without_modification()` function which
	  allows saving an item that might be a subtree or a single setting, without changing the
	  value. To save a single setting, the setting must support reading and writing of it
	  using the `h_get()` function pointer and must support reading it into a large buffer
	  size.

config SETTINGS_SAVE_SINGLE_SUBTREE_WITHOUT_MODIFICATION_VALUE_SIZE
	int "Save single or subtree (without modification) maximum value size"
	default 65
	depends on SETTINGS_SAVE_SINGLE_SUBTREE_WITHOUT_MODIFICATION
	help
	  The maximum size of a single setting that can be saved using the
	  `settings_save_subtree_or_single_without_modification()` function - note that this will
	  use stack memory.

# Hidden option to enable encoding length into settings entry

config SETTINGS_ENCODE_LEN
	bool

endif # SETTINGS
```

## lib/Kconfig
```kconfig
# Copyright (c) 2016 Intel Corporation
# Copyright (c) 2025 Aerlync Labs Inc.
# SPDX-License-Identifier: Apache-2.0

menu "Additional libraries"

rsource "net_buf/Kconfig"
rsource "utils/Kconfig"
rsource "uuid/Kconfig"

endmenu
```

## lib/net_buf/Kconfig
```kconfig
# Network buffer configuration options

# Copyright (c) 2015 Intel Corporation
# SPDX-License-Identifier: Apache-2.0

menuconfig NET_BUF
	bool "Network buffer support"
	help
	  This option enables support for generic network protocol
	  buffers.

if NET_BUF

config NET_BUF_POOL_USAGE
	bool "Network buffer pool usage tracking"
	help
	  Enable network buffer pool tracking. This means that:
	  * amount of free buffers in the pool is remembered
	  * maximum amount of buffers in use at the same time is remembered
	  * total size of the pool is calculated
	  * pool name is stored and can be shown in debugging prints

config NET_BUF_HARDENING
	bool "Network buffer runtime integrity checks"
	help
	  Enable always-on (not assert-gated) integrity checks on the network
	  buffer length/pointer fields before mutating a buffer. A buffer whose
	  len/data have been corrupted so that they no longer fit within the
	  buffer's own storage (e.g. len wrapped to a large value, or data moved
	  outside __buf..__buf+size) is rejected fail-closed: the mutating
	  operation returns NULL instead of reading or writing out of bounds.
	  Operations that return a value return 0 and operations that return
	  nothing do not write, so the caller cannot always tell that an
	  operation was rejected.

	  This turns a would-be out-of-bounds access (in particular the
	  tailroom-underflow -> net_buf_add() overflow) into a controlled
	  failure. It adds a small runtime cost to net_buf_simple_add()/push()/
	  pull()/remove() and is intended for security-sensitive builds; leave
	  disabled to keep the fast path assert-only.

config NET_BUF_ALIGNMENT
	int "Network buffer alignment restriction"
	default 0
	help
	  Alignment restriction for network buffers. This is useful for
	  some hardware IP with DMA that requires the buffers to be aligned
	  to a certain byte boundary, or dealing with cache line restrictions.
	  Default value of 0 means the alignment will be the size of a void pointer,
	  any other value will force the alignment of a net buffer in bytes.

endif # NET_BUF
```

## lib/utils/Kconfig
```kconfig
# Copyright (c) 2016 Intel Corporation
# SPDX-License-Identifier: Apache-2.0

menu "Utility Library"

config RING_BUFFER_LARGE
	bool "Allow large ring buffer sizes"
	help
	  Increase maximum buffer size from 32KB to 1GB. When this is enabled,
	  all struct ring_buf instances grow, as the internal size and index
	  fields widen from 16-bit to 32-bit.

config BASE64
	bool "Base64 encoding and decoding"
	help
	  Enable base64 encoding and decoding functionality

config UTF8
	bool "UTF-8 string operation supported"
	help
	  Enable the utf8 API. The API implements functions to specifically
	  handle UTF-8 encoded strings.

endmenu
```

## lib/uuid/Kconfig
```kconfig
# Copyright (c) 2025, SECO Mind Srl
#
# SPDX-License-Identifier: Apache-2.0

menuconfig UUID
	bool "Universally Unique Identifier (UUID) library"
	help
	  Enable use of the UUID library.

if UUID

config UUID_V4
	bool "UUID version 4 generation support"
	depends on HAS_RANDOM_GENERATOR
	help
	  Enable generation of UUID v4.

config UUID_V5
	bool "UUID version 5 generation support"
	depends on PSA_WANT_ALG_SHA_1
	help
	  Enable generation of UUID v5.

config UUID_BASE64
	bool "UUID Base64 support"
	depends on BASE64
	help
	  Enable conversion functions to write UUIDs in base 64
	  formats.

endif
```
